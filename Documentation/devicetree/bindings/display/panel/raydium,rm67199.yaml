## Documentation/devicetree/bindings/display/panel/raydium,rm67199.yaml
```yaml
# SPDX-License-Identifier: (GPL-2.0-only OR BSD-2-Clause)
%YAML 1.2
---
$id: http://devicetree.org/schemas/display/panel/raydium,rm67199.yaml#
$schema: http://devicetree.org/meta-schemas/core.yaml#

title: Raydium RM67199 Dongxingqiang DXQ5D4408 1080x1920 MIPI-DSI panel

maintainers:
  - Heiko Stuebner <heiko@sntech.de>

allOf:
  - $ref: panel-common.yaml#

properties:
  compatible:
    oneOf:
      - const: dongxingqiang,dxq5d4408
      - const: raydium,rm67199-dxq5d4408

  reg: true
  port: true
  reset-gpios: true
  width-mm: true
  height-mm: true
  rotation: true

  vbat-supply:
    description: Main panel supply.

  vddio-supply:
    description: I/O supply.

  vci-supply:
    description: Driver logic supply.

required:
  - compatible
  - reg
  - reset-gpios
  - vbat-supply
  - vddio-supply
  - vci-supply
  - port

additionalProperties: false

examples:
  - |
    #include <dt-bindings/gpio/gpio.h>

    dsi {
        #address-cells = <1>;
        #size-cells = <0>;

        panel@0 {
            compatible = "dongxingqiang,dxq5d4408";
            reg = <0>;
            reset-gpios = <&gpio1 22 GPIO_ACTIVE_LOW>;
            vbat-supply = <&vcc_lcd_vbat>;
            vddio-supply = <&vcc_1v8>;
            vci-supply = <&vcc_3v3>;

            port {
                panel_in: endpoint {
                    remote-endpoint = <&mipi_out>;
                };
            };
        };
    };

...
```

## drivers/input/touchscreen/focaltech_touch_FT3519/Kconfig
```kconfig
#
# Focaltech Touchscreen driver configuration
#

config TOUCHSCREEN_FTS_FT3519
    tristate "Focaltech FT3519 Touchscreen"
    depends on I2C
    default m
    help
      Say Y here if you have a Focaltech FT3519 touch panel.
      If unsure, say N.
```

## drivers/net/wireless/rockchip_wlan/rkwifi/Kconfig
```kconfig
# SPDX-License-Identifier: GPL-2.0
config AP6XXX
	tristate "ap6xxx wireless cards support"
	depends on RFKILL_RK
	select CFG80211
	select MAC80211
	help
	  This module adds support for wireless adapters based on
	  Broadcom ap6xxx chipset.

	  This driver uses the kernel's wireless extensions subsystem.

	  If you choose to build a module, it'll be called dhd. Say M if
	  unsure.

choice
	prompt "Enable Chip Interface"
	depends on BCMDHD
	default BCMDHD_SDIO
	help
	  Enable Chip Interface.

config BCMDHD_SDIO
	bool "SDIO bus interface support"
	depends on BCMDHD && MMC

config BCMDHD_PCIE
	bool "PCIe bus interface support"
	depends on BCMDHD && PCI

endchoice

config BCMDHD_DEBUG
	bool "Enable bcmdhd debug support"
	depends on BCMDHD
	default y
	help
	  Enable the base DHD_DEBUG code paths in the Broadcom bcmdhd driver.

config BCMDHD_DEBUG2
	bool "Enable extended bcmdhd debug support"
	depends on BCMDHD_DEBUG
	default n
	help
	  Enable extra log dump and assertion tracing paths in bcmdhd.

config BCMDHD_PLATFORM
	bool "Enable bcmdhd platform data support"
	depends on BCMDHD
	default y
	help
	  Enable Rockchip platform GPIO/power integration for bcmdhd.

config BCMDHD_DTS
	bool "Enable bcmdhd device tree GPIO parsing"
	depends on BCMDHD_PLATFORM
	default y
	help
	  Read WL_REG_ON and WL_HOST_WAKE GPIOs from the bcmdhd device tree node.

config BCMDHD_OOB_INTR
	bool "Enable bcmdhd out-of-band interrupt"
	depends on BCMDHD && BCMDHD_SDIO
	default y
	help
	  Use WL_HOST_WAKE as the bcmdhd SDIO out-of-band interrupt.

config BCMDHD_LOGDUMP
	bool "Enable bcmdhd log dump support"
	depends on BCMDHD
	default y

config BCMDHD_STATIC_BUF
	bool "Enable bcmdhd static buffer support"
	depends on BCMDHD
	default y

config BCMDHD_STATIC_BUF_IN_DHD
	bool "Allocate bcmdhd static buffers in driver"
	depends on BCMDHD_STATIC_BUF
	default y

config BCMDHD_HS_OFFLOAD
	bool "Enable bcmdhd WPA/SAE/OWE handshake offload"
	depends on BCMDHD
	default n
	help
	  Enable dongle handshake offload paths in bcmdhd. Leave this off
	  unless the cfg80211 backports required by this driver are present.

config BCMDHD_HS_BKPORT
	bool "Enable bcmdhd handshake offload backports"
	depends on BCMDHD_HS_OFFLOAD
	default n

config PCIEASPM_ROCKCHIP_WIFI_EXTENSION
	bool "Extend ASPM function"
	depends on BCMDHD_PCIE && PCIEASPM_EXT
	help
	  This enables the extensions APIs for ASPM control.

config BCMDHD_FW_PATH
	depends on BCMDHD
	string "Firmware path"
	default "/vendor/etc/firmware/fw_bcmdhd.bin"
	help
	  Path to the firmware file.

config BCMDHD_NVRAM_PATH
	depends on BCMDHD
	string "NVRAM path"
	default "/vendor/etc/firmware/nvram.txt"
	help
	  Path to the calibration file.a

config BCMDHD_STATIC_IF
	bool "Enable wlan1 support"
	help
	  default to add wlan1 interface
```

## drivers/staging/android/Kconfig
```kconfig
# SPDX-License-Identifier: GPL-2.0
menu "Android"

if ANDROID

config ASHMEM
	bool "Enable the Anonymous Shared Memory Subsystem"
	depends on SHMEM
	help
	  The ashmem subsystem is a new shared memory allocator, similar to
	  POSIX SHM but with different behavior and sporting a simpler
	  file-based API.

	  It is, in theory, a good memory allocator for low-memory devices,
	  because it can discard shared memory units when under memory pressure.

config DEBUG_KINFO
	bool "Debug Kernel Information Support"
	depends on KALLSYMS
	help
	  This supports kernel information backup for bootloader usage.
	  Specifics:
	   - The kallsyms symbols for unwind_backtrace
	   - Page directory pointer
	   - UTS_RELEASE
	   - BUILD_INFO(ro.build.fingerprint)

config ANDROID_TIMED_OUTPUT
	bool "Timed output class driver"
	default y

config ANDROID_TIMED_GPIO
	tristate "Android timed gpio driver"
	depends on GPIOLIB || COMPILE_TEST
	depends on ANDROID_TIMED_OUTPUT
	default n
	help
	  Unlike generic gpio is to allow programs to access and manipulate gpio
	  registers from user space, timed output/gpio is a system to allow changing
	  a gpio pin and restore it automatically after a specified timeout.

source "drivers/staging/android/ion/Kconfig"

endif # if ANDROID

endmenu
```
